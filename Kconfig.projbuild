## Kconfig.projbuild
```kconfig
# Kconfig file for Robusto v0.1.0


menu "Test"
    config TEST_LIB_DEF
        bool "Lib dep test config"
        help
            Testing configs in dependencies

endmenu
```

## scripts/Kconfig.template
```kconfig
orsource "components/**/Kconfig"
orsource "components/**/Kconfig.projbuild"
orsource ".pio/libdeps/RaspberryPi_Pico/**/Kconfig"
orsource ".pio/libdeps/RaspberryPi_Pico/**/Kconfig.projbuild"
```
